## fw/boards/shields/display/Kconfig.defconfig
```kconfig
if SHIELD_DISPLAY_UC1609

config SPI
    default y

config DISPLAY
    default y

config UC1609
    default y

endif

if SHIELD_DISPLAY_SSD1306

config SPI
    default y

config DISPLAY
    default y

config SSD1306
    bool "Enable SSD1306 display controller support"
    default y

endif

if SHIELD_DISPLAY_SH1106

config SPI
    default y

config DISPLAY
    default y

config SH1106
    bool "Enable SH1106 display controller support"
    default y

endif
```

## fw/dts/bindings/nexrx,si5351-oeb.yaml
```yaml
# Copyright (c) 2026 Starview Labs (starviewlabs.com)
# SPDX-License-Identifier: Apache-2.0

description: NexRx Si5351 Output Enable Control

compatible: "nexrx,si5351-oeb"

properties:
  oe-gpios:
    type: phandle-array
    description: Output enable GPIO pin (active low)
```
