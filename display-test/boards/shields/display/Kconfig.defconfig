## display-test/boards/shields/display/Kconfig.defconfig
```kconfig
if SHIELD_DISPLAY_UC1609
config DISPLAY
    default y
config UC1609
    default y
endif

if SHIELD_DISPLAY_SSD1306
config DISPLAY
    default y
config SSD1306
    bool
    default y
endif

if SHIELD_DISPLAY_SH1106
config DISPLAY
    default y
config SH1106
    bool
    default y
endif
```

## display-test/boards/shields/display/Kconfig.shield
```kconfig
config SHIELD_DISPLAY_UC1609
    def_bool $(shields_list_contains,display_uc1609)

config SHIELD_DISPLAY_SSD1306
    def_bool $(shields_list_contains,display_ssd1306)

config SHIELD_DISPLAY_SH1106
    def_bool $(shields_list_contains,display_sh1106)
```

## display-test/drivers/display/Kconfig.uc1609
```kconfig
menuconfig UC1609
        bool "UC1609 display controller"
        default y
        depends on DT_HAS_ZEPHYR_UC1609_ENABLED
        select I2C if $(dt_compat_on_bus,$(DT_COMPAT_ZEPHYR_UC1609),i2c)
        select MIPI_DBI if $(dt_compat_on_bus,$(DT_COMPAT_ZEPHYR_UC1609),mipi-dbi)
        help
          Enable driver for UC1609 display controller.

if UC1609

module = UC1609
module-str = uc1609
source "subsys/logging/Kconfig.template.log_config"

config UC1609_DEFAULT_CONTRAST
        int "UC1609 default contrast"
        default 154
        range 0 255
        help
          UC1609 default contrast.

endif # UC1609
```

## fw/boards/arm/nexrx/nexrx_defconfig
```kconfig
CONFIG_SOC_SERIES_STM32H7X=y
CONFIG_SOC_STM32H753XX=y
CONFIG_BOARD_NEXRX=y

# Clock configuration
CONFIG_CLOCK_CONTROL=y
CONFIG_CLOCK_STM32_SYSCLK_SRC_PLL=y
CONFIG_CLOCK_STM32_HSE_CLOCK=26000000

# Console
CONFIG_SERIAL=y
CONFIG_UART_INTERRUPT_DRIVEN=y
```

## fw/boards/nexrx/board.yml
```yaml
board:
  name: nexrx
  full_name: NexRx Receiver Board
  vendor: nexrx
  socs:
    - name: stm32h743xx
```

## fw/boards/nexrx/nexrx_defconfig
```kconfig
# Serial Drivers
CONFIG_SERIAL=y
CONFIG_UART_INTERRUPT_DRIVEN=y

# Console
CONFIG_CONSOLE=y
CONFIG_UART_CONSOLE=y

# GPIO Controller
CONFIG_GPIO=y
```
